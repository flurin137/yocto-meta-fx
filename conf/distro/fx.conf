## conf/distro/fx.conf
```bitbake
require conf/distro/poky.conf

DISTRO = "fx"
DISTRO_NAME = "fx base distro"
DISTRO_VERSION = "0.0.1"

MAINTAINER = "Flurin Feuerstein <flufeu@gmail.com>"

RPI_USE_U_BOOT = "1"
```

## conf/layer.conf
```bitbake
# We have a conf and classes directory, add to BBPATH
BBPATH .= ":${LAYERDIR}"

# We have recipes-* directories, add to BBFILES
BBFILES += "${LAYERDIR}/recipes-*/*/*.bb \
            ${LAYERDIR}/recipes-*/*/*.bbappend"

BBFILE_COLLECTIONS += "meta-fx"
BBFILE_PATTERN_meta-fx = "^${LAYERDIR}/"
BBFILE_PRIORITY_meta-fx = "6"

LAYERDEPENDS_meta-fx = "core"
LAYERSERIES_COMPAT_meta-fx = "dunfell"
```
